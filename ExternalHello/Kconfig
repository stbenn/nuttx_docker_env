## ExternalHello/Kconfig
```kconfig
#
# For a description of the syntax of this configuration file,
# see the file kconfig-language.txt int he NuttX tools repository.
#

config EXTERNAL_APPS_HELLO_APP
	bool "External Hello Application"
	default n

if EXTERNAL_APPS_HELLO_APP

config EXTERNAL_APPS_HELLO_APP_PROGNAME
	string "Program name"
	default "external_hello"
	---help---
		This is the name of the program that will be used when the NSH ELF 
		program is installed.

config EXTERNAL_APPS_HELLO_APP_PRIORITY
	int "External hello task priority"
	default 100

config EXTERNAL_APPS_HELLO_APP_STACKSIZE
	int "External hello stack size"
	default DEFAULT_TASK_STACKSIZE

endif
```
